## arch/arm/mach-meson6/Kconfig.boards
```kconfig
if ARCH_MESON6

config MACH_MESON6_SKT
	depends on ARCH_MESON6
	bool "Meson6 socket board"
	default y 
	help
          Support for Amlogic Meson6 socket board.

config MACH_MESON6_REF
	depends on ARCH_MESON6
	bool "Meson6 reference board"
	default y 
	help
          Support for Amlogic Meson6 reference development platform.

config MACH_MESON6_G02
        depends on ARCH_MESON6
        bool "Meson6 g02 board"
        help
          Support for Amlogic Meson6 g02 reference platform.

config MACH_MESON6_ATV520
        depends on MACH_MESON6_G02
        bool "MyGicca ATV 520"
        default y
	help
          Support for Mygicca atv520.
config MACH_MESON6_ATV1200
        depends on MACH_MESON6_G02
        bool "MyGicca ATV 1200"
        help
          Support for Mygicca atv1200.


endif # ARCH_MESON6
```

## drivers/amlogic/d2d3/Kconfig
```kconfig
menuconfig D2D3
       tristate "AMLOGIC D2D3 SUPPORT"
       default n 
if D2D3
        config D2D3_SUPPORT
        tristate "AMLOGIC D2D3 SUPORT"
        default n
        help 
                "AMLOGIC D2D3 DRIVER SUPPORT"
endif
```

## drivers/amlogic/power/axp_power/Kconfig
```kconfig
menuconfig AW_AXP
	bool "AXP Power drivers"
	select I2C
	select REGULATOR
	default n
	---help---
	  This option allows you to select AXP power driver

if AW_AXP

choice
	prompt "AXP PMU type"
	default AW_AXP20

config AW_AXP18
	bool "AXP18 driver"
	---help---
	  AXP18 driver

config AW_AXP19
	bool "AXP19 driver"
	---help---
	  AXP19 driver

config AW_AXP20
	bool "AXP20 driver"
	---help---
	  AXP20 driver

endchoice

config AXP_CHARGEINIT
	bool "AXP initial charging environment set"
	default y

config AXP_CHGCHANGE
	bool "AXP charging current set when suspend\resume\shutdown"
	default y


# //add OCV Measurement by wch
config AXP_USE_OCV
	bool "AXP use ocv measure battery cap"
	help
		"If you choose this way, you should not use axp KULUNJI measure battery cap."	
	default n	
	
config UBOOT_BATTERY_PARAMETERS
    bool "BATTERY PARAMETERS FROM UBOOT" 
    help 
        select this option when your battery parameters is passed from uboot
    default n

endif # !AW_AXP
```

## drivers/amlogic/sensors/Kconfig
```kconfig
menuconfig AM_SENSORS
	bool "Amlogic Sensors support"
	default n

if AM_SENSORS

config MPU3050
	bool "InvenSense MPU-3050 6-axis sensor"
	depends on MISC_DEVICES
	default n
	help
	 Invensense mpu3050 sensors
	source "drivers/amlogic/sensors/mpu3050/Kconfig"

config LIGHT_SENSOR
	bool "LightSensor"
	depends on INPUT
	default n
	help
	 GL3526 Light Sensor

config AMLOGIC_Gsnesor
	bool "amlogic Gsensor driver for 3-axis accelaration sensors"
	depends on I2C
	default n
	help
	 Say Y here if you want to use the amlogic Gsensor drivers.
	source "drivers/amlogic/sensors/aml_Gsensor/Kconfig"
	 	 
endif # AM_SENSORS
```

## drivers/amlogic/tvin/Kconfig
```kconfig
#
# Amlogic tvin devices configuration
#

menuconfig TVIN
	tristate "Amlogic TVIN support"
	default n

if TVIN

source "drivers/amlogic/tvin/vdin/Kconfig"
source "drivers/amlogic/tvin/tvafe/Kconfig"
source "drivers/amlogic/tvin/hdmirx/Kconfig"
source "drivers/amlogic/tvin/bt656/Kconfig"

endif
```

## drivers/amlogic/video_dev/Kconfig
```kconfig
config V4L_AMLOGIC_VIDEO
	tristate "Amlogic v4l video device support"
    default n
	help
	  Select to enable "Amlogic v4l video device support.
```
